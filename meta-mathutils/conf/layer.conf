## meta-mathutils/conf/layer.conf
```bitbake
# We have a conf and classes directory, add to BBPATH
BBPATH .= ":${LAYERDIR}"

# We have recipes-* directories, add to BBFILES
BBFILES += "${LAYERDIR}/recipes-*/*/*.bb \
            ${LAYERDIR}/recipes-*/*/*.bbappend"

BBFILE_COLLECTIONS += "meta-mathutils"
BBFILE_PATTERN_meta-mathutils = "^${LAYERDIR}/"
BBFILE_PRIORITY_meta-mathutils = "6"

LAYERDEPENDS_meta-mathutils = "core"
LAYERSERIES_COMPAT_meta-mathutils = "kirkstone"
```
